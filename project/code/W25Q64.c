/*********************************************************************************************************************
* CYT4BB Opensourec Library 基于逐飞库软件SPI接口封装的W25Q64 SPI NorFlash驱动
* Copyright (c) 2026 YourName
*
* 文件名称   W25Q64
* 版本信息   v1.0.0
* 开发环境   IAR 9.40.1
* 适用平台   CYT4BB
*
* 修改记录
* 日期        作者        备注
* 2026-08-08  YourName    first version
********************************************************************************************************************/

#include "zf_common_headfile.h"
#include "W25Q64.h"

// ====================================================内部变量====================================================
static soft_spi_info_struct w25q64_spi_struct;   // 软件SPI对象
uint32 w25q64_chip_id = 0;                       // 芯片JEDEC ID

// ====================================================命令宏====================================================
#define W25Q64_CMD_WRITE_ENABLE       0x06    // 写使能
#define W25Q64_CMD_WRITE_DISABLE      0x04    // 写禁用
#define W25Q64_CMD_READ_STATUS        0x05    // 读状态寄存器
#define W25Q64_CMD_WRITE_STATUS       0x01    // 写状态寄存器
#define W25Q64_CMD_READ_DATA          0x03    // 读数据
#define W25Q64_CMD_FAST_READ          0x0B    // 快速读
#define W25Q64_CMD_PAGE_PROGRAM       0x02    // 页编程
#define W25Q64_CMD_SECTOR_ERASE       0x20    // 扇区擦除 (4KB)
#define W25Q64_CMD_BLOCK_ERASE        0xD8    // 块擦除 (64KB)
#define W25Q64_CMD_CHIP_ERASE         0xC7    // 整片擦除
#define W25Q64_CMD_POWER_DOWN         0xB9    // 掉电
#define W25Q64_CMD_RELEASE_POWER_DOWN 0xAB    // 唤醒
#define W25Q64_CMD_JEDEC_ID           0x9F    // 读JEDEC ID

// ====================================================内部函数====================================================
//-------------------------------------------------------------------------------------------------------------------
// 函数简介     CS 拉低 (选中)
// 参数说明     void
// 返回参数     void
// 备注信息     内部调用
//-------------------------------------------------------------------------------------------------------------------
static void w25q64_cs_low(void)
{
    gpio_low(W25Q64_CS_PIN);
}

//-------------------------------------------------------------------------------------------------------------------
// 函数简介     CS 拉高 (释放)
// 参数说明     void
// 返回参数     void
// 备注信息     内部调用
//-------------------------------------------------------------------------------------------------------------------
static void w25q64_cs_high(void)
{
    gpio_high(W25Q64_CS_PIN);
}

//-------------------------------------------------------------------------------------------------------------------
// 函数简介     发送一字节 (并丢弃返回)
// 参数说明     dat     待发送字节
// 返回参数     void
// 备注信息     内部调用, CS 由调用方控制
//-------------------------------------------------------------------------------------------------------------------
static void w25q64_send_byte(uint8 dat)
{
    soft_spi_write_8bit(&w25q64_spi_struct, dat);
}

//-------------------------------------------------------------------------------------------------------------------
// 函数简介     读取一字节
// 参数说明     void
// 返回参数     uint8   读到的字节
// 备注信息     内部调用, CS 由调用方控制
//-------------------------------------------------------------------------------------------------------------------
static uint8 w25q64_read_byte(void)
{
    return soft_spi_read_8bit(&w25q64_spi_struct);
}

//-------------------------------------------------------------------------------------------------------------------
// 函数简介     发送 24 位地址 (A23~A0, 高字节在前)
// 参数说明     addr    24位地址
// 返回参数     void
// 备注信息     内部调用, 必须在命令字节之后、CS 保持低期间
//-------------------------------------------------------------------------------------------------------------------
static void w25q64_send_addr(uint32 addr)
{
    w25q64_send_byte((uint8)((addr >> 16) & 0xFF));
    w25q64_send_byte((uint8)((addr >> 8)  & 0xFF));
    w25q64_send_byte((uint8)(addr & 0xFF));
}

//-------------------------------------------------------------------------------------------------------------------
// 函数简介     写使能 (0x06)
// 参数说明     void
// 返回参数     void
// 备注信息     擦除/编程前必须执行, 否则操作被忽略
//-------------------------------------------------------------------------------------------------------------------
static void w25q64_write_enable(void)
{
    w25q64_cs_low();
    w25q64_send_byte(W25Q64_CMD_WRITE_ENABLE);
    w25q64_cs_high();
}

//-------------------------------------------------------------------------------------------------------------------
// 函数简介     读状态寄存器
// 参数说明     void
// 返回参数     uint8   状态寄存器值 (bit0 = WIP 忙标志)
// 备注信息     内部调用
//-------------------------------------------------------------------------------------------------------------------
static uint8 w25q64_read_status(void)
{
    uint8 status;
    w25q64_cs_low();
    w25q64_send_byte(W25Q64_CMD_READ_STATUS);
    status = w25q64_read_byte();
    w25q64_cs_high();
    return status;
}

//-------------------------------------------------------------------------------------------------------------------
// 函数简介     等待写操作完成 (轮询 WIP 位)
// 参数说明     void
// 返回参数     void
// 备注信息     擦除/编程后调用
//-------------------------------------------------------------------------------------------------------------------
static void w25q64_wait_busy(void)
{
    while(w25q64_read_status() & W25Q64_STATUS_WIP);
}

// ====================================================API函数实现====================================================
//-------------------------------------------------------------------------------------------------------------------
// 函数简介     初始化 W25Q64
//-------------------------------------------------------------------------------------------------------------------
uint8 w25q64_init(void)
{
    // 初始化软件SPI (Mode 3), CS 由本驱动手动控制 (传 SOFT_SPI_PIN_NULL 禁用库的CS)
    soft_spi_init(&w25q64_spi_struct, W25Q64_SOFT_SPI_MODE, W25Q64_SOFT_SPI_DELAY,
                  W25Q64_SCK_PIN, W25Q64_MOSI_PIN, W25Q64_MISO_PIN, SOFT_SPI_PIN_NULL);
    // 手动初始化 CS 引脚 (库未初始化, 因为传了 NULL)
    gpio_init(W25Q64_CS_PIN, GPO, GPIO_HIGH, GPO_PUSH_PULL);

    // 读芯片ID判断是否检测到设备
    w25q64_chip_id = w25q64_read_id();
    switch(w25q64_chip_id)
    {
        case W25Q64_JEDEC_ID:
        case W25Q128_JEDEC_ID:
        case W25Q32_JEDEC_ID:
        case W25Q16_JEDEC_ID:
        case W25Q80_JEDEC_ID:
            return 0;   // 检测到 W25Q 系列
        default:
            return 1;   // 未检测到设备
    }
}

//-------------------------------------------------------------------------------------------------------------------
// 函数简介     读 JEDEC 设备ID
//-------------------------------------------------------------------------------------------------------------------
uint32 w25q64_read_id(void)
{
    uint8 m, t, c;
    w25q64_cs_low();
    w25q64_send_byte(W25Q64_CMD_JEDEC_ID);
    m = w25q64_read_byte();     // Manufacturer ID = 0xEF (Winbond)
    t = w25q64_read_byte();     // Memory Type      = 0x40
    c = w25q64_read_byte();     // Capacity         = 0x17 (64Mbit)
    w25q64_cs_high();
    return ((uint32)m << 16) | ((uint32)t << 8) | c;
}

//-------------------------------------------------------------------------------------------------------------------
// 函数简介     擦除一个扇区 (4KB)
//-------------------------------------------------------------------------------------------------------------------
void w25q64_sector_erase(uint32 addr)
{
    w25q64_write_enable();
    w25q64_cs_low();
    w25q64_send_byte(W25Q64_CMD_SECTOR_ERASE);
    w25q64_send_addr(addr);
    w25q64_cs_high();
    w25q64_wait_busy();
}

//-------------------------------------------------------------------------------------------------------------------
// 函数简介     擦除一个块 (64KB)
//-------------------------------------------------------------------------------------------------------------------
void w25q64_block_erase(uint32 addr)
{
    w25q64_write_enable();
    w25q64_cs_low();
    w25q64_send_byte(W25Q64_CMD_BLOCK_ERASE);
    w25q64_send_addr(addr);
    w25q64_cs_high();
    w25q64_wait_busy();
}

//-------------------------------------------------------------------------------------------------------------------
// 函数简介     整片擦除
//-------------------------------------------------------------------------------------------------------------------
void w25q64_chip_erase(void)
{
    w25q64_write_enable();
    w25q64_cs_low();
    w25q64_send_byte(W25Q64_CMD_CHIP_ERASE);
    w25q64_cs_high();
    w25q64_wait_busy();
}

//-------------------------------------------------------------------------------------------------------------------
// 函数简介     页编程 (≤256字节)
//-------------------------------------------------------------------------------------------------------------------
void w25q64_page_write(const uint8 *buf, uint32 addr, uint16 len)
{
    if(len > W25Q64_PAGE_SIZE)
    {
        len = W25Q64_PAGE_SIZE;
    }
    w25q64_write_enable();
    w25q64_cs_low();
    w25q64_send_byte(W25Q64_CMD_PAGE_PROGRAM);
    w25q64_send_addr(addr);
    while(len--)
    {
        w25q64_send_byte(*buf++);
    }
    w25q64_cs_high();
    w25q64_wait_busy();
}

//-------------------------------------------------------------------------------------------------------------------
// 函数简介     连续写入任意长度 (自动跨页)
//-------------------------------------------------------------------------------------------------------------------
void w25q64_write(const uint8 *buf, uint32 addr, uint32 len)
{
    while(len > 0)
    {
        // 本页可写字节数 = 页大小 - 页内偏移
        uint16 page_remain = W25Q64_PAGE_SIZE - (uint16)(addr % W25Q64_PAGE_SIZE);
        uint16 chunk = (len < page_remain) ? (uint16)len : page_remain;
        w25q64_page_write(buf, addr, chunk);
        buf   += chunk;
        addr  += chunk;
        len   -= chunk;
    }
}

//-------------------------------------------------------------------------------------------------------------------
// 函数简介     连续读取任意长度
//-------------------------------------------------------------------------------------------------------------------
void w25q64_read(uint8 *buf, uint32 addr, uint32 len)
{
    w25q64_cs_low();
    w25q64_send_byte(W25Q64_CMD_READ_DATA);
    w25q64_send_addr(addr);
    while(len--)
    {
        *buf++ = w25q64_read_byte();
    }
    w25q64_cs_high();
}

//-------------------------------------------------------------------------------------------------------------------
// 函数简介     掉电模式
//-------------------------------------------------------------------------------------------------------------------
void w25q64_power_down(void)
{
    w25q64_cs_low();
    w25q64_send_byte(W25Q64_CMD_POWER_DOWN);
    w25q64_cs_high();
}

//-------------------------------------------------------------------------------------------------------------------
// 函数简介     唤醒
//-------------------------------------------------------------------------------------------------------------------
void w25q64_wake_up(void)
{
    w25q64_cs_low();
    w25q64_send_byte(W25Q64_CMD_RELEASE_POWER_DOWN);
    w25q64_cs_high();
}

/******************************END OF FILE******************************/
